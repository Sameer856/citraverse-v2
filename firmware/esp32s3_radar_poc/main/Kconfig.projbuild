## firmware/esp32s3_radar_poc/main/Kconfig.projbuild
```kconfig
menu "Citraverse radar PoC"
config RADAR_SPI_HZ
    int "Requested SPI clock (Hz)"
    range 500000 8000000
    default 8000000
config RADAR_AUTO_CONFIGURE
    bool "Configure radar through PB0/PB1 shell UART on startup"
    default y
    help
        Requires radar-analysis firmware exposing mmwc on UART0.
        Configure RAM settings and start SPI point reporting; no flash writes.
config RADAR_FRAME_MS
    int "Requested frame period (ms)"
    range 41 1000
    default 50
    help
        Start at 50 ms (20 FPS). Use 41 ms for an at-least-24-FPS test.
endmenu
```

## firmware/esp32s3_radar_poc/sdkconfig.defaults
```kconfig
CONFIG_IDF_TARGET="esp32s3"
CONFIG_ESPTOOLPY_FLASHSIZE_16MB=y
CONFIG_ESP_CONSOLE_UART_DEFAULT=y
CONFIG_ESP_CONSOLE_SECONDARY_NONE=y
CONFIG_COMPILER_OPTIMIZATION_SIZE=y
# No PSRAM required.
CONFIG_ESP_MAIN_TASK_STACK_SIZE=8192
CONFIG_PARTITION_TABLE_CUSTOM=y
CONFIG_PARTITION_TABLE_CUSTOM_FILENAME="partitions.csv"

CONFIG_HTTPD_WS_SUPPORT=y
CONFIG_LWIP_MAX_SOCKETS=20
# CONFIG_PM_ENABLE is not set
CONFIG_ESP_DEFAULT_CPU_FREQ_MHZ_160=y
```
