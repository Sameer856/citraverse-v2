## firmware/esp32s3_radar_poc/main/Kconfig.projbuild
```kconfig
menu "Citraverse radar PoC"
config CITRAVERSE_PCB
    bool "Custom PCB: switched radar, inverted reset, native USB, no radar flashing"
    default y
config RADAR_SPI_HZ
    int "Requested SPI clock (Hz)"
    range 500000 8000000
    default 1000000
config RADAR_AUTO_CONFIGURE
    bool "Configure radar through PB0/PB1 shell UART on startup"
    default y
    help
        Requires radar-analysis firmware exposing mmwc on UART0.
        Configure RAM settings and start SPI point reporting; no flash writes.
config RADAR_FRAME_MS
    int "Requested frame period (ms)"
    range 41 1000
    default 50
    help
        Start at 50 ms (20 FPS). Use 41 ms for an at-least-24-FPS test.
config PCB_SD_RECORD_LIMIT_MB
    int "Maximum rotating radar/audio records (MiB)"
    range 64 16384
    default 1024
endmenu
```

## firmware/esp32s3_radar_poc/sdkconfig.defaults
```kconfig
CONFIG_IDF_TARGET="esp32s3"
CONFIG_ESPTOOLPY_FLASHSIZE_16MB=y
CONFIG_ESP_CONSOLE_USB_SERIAL_JTAG=y
CONFIG_ESP_CONSOLE_SECONDARY_NONE=y
CONFIG_COMPILER_OPTIMIZATION_SIZE=y
# PSRAM is required for bounded radar/audio histories.
CONFIG_ESP_MAIN_TASK_STACK_SIZE=8192
CONFIG_PARTITION_TABLE_CUSTOM=y
CONFIG_PARTITION_TABLE_CUSTOM_FILENAME="partitions.csv"
CONFIG_BOOTLOADER_APP_ROLLBACK_ENABLE=y

CONFIG_HTTPD_WS_SUPPORT=y
CONFIG_LWIP_MAX_SOCKETS=20
# CONFIG_PM_ENABLE is not set
CONFIG_ESP_DEFAULT_CPU_FREQ_MHZ_160=y
CONFIG_SPIRAM=y
CONFIG_SPIRAM_MODE_OCT=y
CONFIG_SPIRAM_SPEED_40M=y
# CONFIG_SPIRAM_USE_CAPS_ALLOC is not set
CONFIG_SPIRAM_MEMTEST=y

CONFIG_CITRAVERSE_PCB=y

CONFIG_RADAR_SPI_HZ=1000000
CONFIG_PCB_SD_RECORD_LIMIT_MB=1024

CONFIG_FATFS_LFN_HEAP=y
CONFIG_FATFS_MAX_LFN=64

CONFIG_ESP_SYSTEM_EVENT_TASK_STACK_SIZE=4096
CONFIG_FREERTOS_WATCHPOINT_END_OF_STACK=y
CONFIG_HEAP_POISONING_LIGHT=y

CONFIG_MBEDTLS_EXTERNAL_MEM_ALLOC=y
CONFIG_ESP_WS_CLIENT_ALLOC_IN_EXT_RAM=y
CONFIG_ESP_WS_CLIENT_SEPARATE_TX_LOCK=y

CONFIG_SPIRAM_USE_MALLOC=y
CONFIG_SPIRAM_MALLOC_ALWAYSINTERNAL=2048
CONFIG_SPIRAM_MALLOC_RESERVE_INTERNAL=32768

# Avoid internal DMA bounce-buffer pressure with continuous TLS audio.
# CONFIG_MBEDTLS_HARDWARE_AES is not set
```
